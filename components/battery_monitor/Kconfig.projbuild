## components/battery_monitor/Kconfig.projbuild
```kconfig
menu "Battery monitor"

    config BATTERY_CHARGE_CURVE_POINT_COUNT
        int "Number of entries for the battery charge/discharge curve"
        default 21
        help
            Each entry associates a given battery voltage (in mv) to a charge level

    config BATTERY_MIN_CHARGE_VOLTS
        int "Battery voltage at minimum charge (mV)"
        default 3000
        help
            Battery voltage at minimum charge (0%, considering safety offset)

    config BATTERY_MAX_CHARGE_VOLTS
        int "Battery voltage at maximum charge (mV)"
        default 4125
        help
            Battery voltage at maximum charge (100%, considering overcharge offset)
    
    config BATTERY_INPUT_GPIO
        int "GPIO to battery voltage"
        default 35
        help 
            The ADC GPIO used to measure the current battery voltage
endmenu
```

## components/ble_driver/Kconfig.projbuild
```kconfig
menu "BLE Device Configuration"

    config BLE_DEVICE_NAME
        string "BLE Public Device Name"
        default "Hydrate-0000"

    config BLE_FIRST_ADV_DURATION_MS
        int "Duration of the first BLE pair attempt (ms)"
        default 180000
        help 
            The duration in milliseconds of the first connection attempt.

    config BLE_ADDITIONAL_ADV_ATTEMPT_COUNT
        int "Number of additional advertising attempts before sleep"
        default 3
        help
            The amount of times the device will reactivate BLE to try to pair with the client before sleeping.

    config BLE_ADDITIONAL_ADV_DURATION_MS
        int "Duration of additional BLE pair attempts (ms)"
        default 30000
        help 
            The duration in milliseconds of any additional connection attempts.
endmenu
```

## components/hx711/Kconfig.projbuild
```kconfig
menu "Sensor and measurement configuration"

    config HX711_PD_SCK_GPIO
        int "PD/SCK GPIO number"
        default 18 if IDF_TARGET_ESP32
        help
            GPIO number connected to PD/SCK pin of hx711

    config HX711_DATA_OUT_GPIO
        int "Data out (DOUT) GPIO number"
        default 19 if IDF_TARGET_ESP32
        help
            GPIO number connected to DOUT pin of hx711

    config HX711_AVG_SAMPLES_COUNT
        int "Number of hx711 measurement samples to average"
        default 5
        
endmenu
```

## components/mpu6050_sensor/Kconfig.projbuild
```kconfig
menu "MPU"

    config I2C_SDA_IO
        int "I2C SDA GPIO number"
        default 21 if IDF_TARGET_ESP32
        help
            GPIO number connected to SDA line of I2C

    config I2C_SCL_IO
        int "I2C SCL GPIO number"
        default 22 if IDF_TARGET_ESP32
        help
            GPIO number connected to SCL line of I2C

    config I2C_MASTER_FREQ_HZ
        int "I2C bus frequency as master (Hz)"
        default 100000
        help
            The frequency of the I2C bus as master device, in Hertz

    config MPU_INT_GPIO
        int "MPU Interrupt GPIO number"
        default 15 if IDF_TARGET_ESP32
        help
            GPIO number connected to INT pin of MPU (Active low)

    config MPU_I2C_ADDRESS
        hex "MPU6050 I2C address"
        default 0x68
        help
            Adress of the MPU6050 sensor in the I2C bus.

    config MPU_MOT_DETECT_THRESHOLD
        int "MPU motion detection threshold (mg)"
        default 20

    config MPU_MOT_DETECT_DURATION_MS
        int "MPU motion detection duration (ms)"
        default 1

    config MPU_INT_ACTIVE_LOW
        bool "Set INT pin as active low"
        help
            If true, INT pin of the MPU will be configured as active low.
            
    config MPU_INT_OPEN_DRAIN
        bool "Configure INT pin as open drain"
        help
            If true, INT pin will be configured as open drain. Otherwise, it will be set as pull-push.

    config MPU_INT_LATCH_EN 
        bool "Latch interrupt on INT pin until cleared"
        help
            If ture, INT pin will be held high until interrupt is cleared.
            
    config MPU_INT_CLEAR_ON_ANY_READ
        bool "Clear MPU interrupt on any register read"
        help
            If true, interrupt status can be cleared with any read, instead of only by reading INT_STATUS.

    config MPU_DATA_SAMPLE_INTERVAL_MS
        int "MPU6050 data sample interval (ms)"
        default 100
        help
            The minimum time to wait before getting another sample from the MPU6050.             

endmenu
```

## components/power-manager/Kconfig.projbuild
```kconfig
menu "Power management configuration"

    config PWR_MANAGER_EXECUTE_PERIOD_MS
        int "Execution interval for power manager (ms)"
        default 15000
        help
            The period in milliseconds between executions of the power manager.

    config LIGHT_SLEEP_ENABLED
        bool "Light sleep enabled"
        default true
        help
            If true, the device will enter light sleep if it is inactive and will optimize CPU and APB frequency.

    config MIN_CPU_FREQ_MHZ
        int "Minimum CPU frequency"
        default 80
        help
            The frequency used when the ESP_PM_CPU_FREQ_MAX lock is not acquired.

    config DEEP_SLEEP_ENABLED
        bool "Deep sleep enabled"
        default true
        help
            If true, the device will enter deep sleep after certain conditions are met.

    config MAX_DEEP_SLEEP_ATTEMPTS
        int "Max attempts to enter deep sleep"
        default 3  
        help
            The number of times the power manager should try to shutdown tasks and enter deep sleep.

    config POWER_ON_GPIO_NUM
        int "GPIO for EXT1 wakeup"
        default 14 if IDF_TARGET_ESP32
        help
            GPIO number of the external input that will be used as a deep sleep wakeup source

    config WAKEUP_ON_MOTION
        bool "Wakeup when MPU detects motion"
        help
            If true, the device will wakeup from sleep whenever the MPU detects considerable acceleration and rotation.

    config WAKEUP_ON_WEIGHT
        bool "Wakeup when weight is lifted"

    config MAX_DEEP_SLEEP_DURATION_MS
        int "Max deep sleep duration in milliseconds"
        default 300000
        help
            Determines the maximum period of time that the chip can spend in deep sleep mode.
        
endmenu
```

## components/storage/Kconfig.projbuild
```kconfig
menu "NVS Storage"
    
    config HYDRATION_RECORD_NVS_NAMESPACE
        string "Hydration record NVS namespace"
        default "hydr-records"

endmenu
```

## main/Kconfig.projbuild
```kconfig
menu "I2C"

    config I2C_SDA_IO
        int "I2C SDA GPIO number"
        default 21 if IDF_TARGET_ESP32
        help
            GPIO number connected to SDA line of I2C

    config I2C_SCL_IO
        int "I2C SCL GPIO number"
        default 22 if IDF_TARGET_ESP32
        help
            GPIO number connected to SCL line of I2C

endmenu
```
